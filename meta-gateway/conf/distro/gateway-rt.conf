## meta-gateway/conf/distro/gateway-rt.conf
```bitbake
DISTRO = "gateway-rt"
DISTRO_NAME = "Gateway RT Distribution"
DISTRO_VERSION = "1.0"
MAINTAINER = "Gateway Team <vasu.padsumbia@gmail.com>"

# Simple packaging
PACKAGE_CLASSES = "package_rpm"

DISTRO_FEATURES:append = " wifi systemd usrmerge"
DISTRO_FEATURES:remove = " x11 wayland pulseaudio"

VIRTUAL-RUNTIME_init_manager = "systemd"
VIRTUAL-RUNTIME_initscripts = ""

ERROR_QA:append = " textrel host-user-contaminated"
WARN_QA:append = " buildpaths ldflags"

# To include custom firmware and kernel by default, uncomment these:
# IMAGE_INSTALL:append = " gateway-firmware-rpi"
# IMAGE_INSTALL:append = " linux-raspberrypi-rt"
# PREFERRED_PROVIDER_virtual/kernel = "linux-raspberrypi-rt"
# KERNEL_DEVICETREE:raspberrypi0-2w-64 = "bcm2837-rpi-zero-2w.dtb"
```

## meta-gateway/conf/layer.conf
```bitbake
BBPATH .= ":${LAYERDIR}"

BBFILES += "${LAYERDIR}/recipes-*/*/*.bb \
            ${LAYERDIR}/recipes-*/*/*.bbappend"

BBFILE_COLLECTIONS += "meta-gateway"
BBFILE_PATTERN_meta-gateway := "^${LAYERDIR}/"
BBFILE_PRIORITY_meta-gateway = "6"

LAYERDEPENDS_meta-gateway = "core"
LAYERSERIES_COMPAT_meta-gateway = "scarthgap walnascar"

BBPATH:append = ":${LAYERDIR}/classes"

BBLAYERS += " \
  ${TOPDIR}/../downloads/meta-raspberrypi \
  ${TOPDIR}/../meta-gateway \
"
# If want to use your custom real-time kernel and firmware, unmask these:
# Mask custom kernel and firmware so only upstream RPi stack is used
BBMASK .= "|meta-gateway/recipes-kernel/linux/linux-raspberrypi-rt.bb"
BBMASK .= "|meta-gateway/recipes-bsp/gateway-firmware/gateway-firmware-rpi.bb"
```

## meta-gateway/conf/machine/gateway-rpi0-2w-64.conf
```bitbake
require conf/machine/raspberrypi0-2w-64.conf

# Additional configurations for Raspberry Pi Zero 2 W with real-time kernel
#IMAGE_FSTYPES = "rpi-sdimg"
BOOTDD_VOLUME_ID = "rpi-gw"
RPI_KERNEL_DEVICETREE = "broadcom/gateway-rpi-rt.dtb"
#IMAGE_BOOT_FILES:remove = "overlay_map.dtb;overlays/overlay_map.dtb"

# 64-bit ARM architecture
DEFAULTTUNE ?= "aarch64"
KERNEL_IMAGETYPE ?= "Image"

IMAGE_FSTYPES += " wic.bz2"
#KERNEL_DEVICETREE = "broadcom/gateway-rpi-rt.dtb"

GATEWAY_FW_DIR = "gateway-firmware/${MACHINE}"

IMAGE_BOOT_FILES += "${GATEWAY_FW_DIR}/bootcode.bin;boot/bootcode.bin \
                   ${GATEWAY_FW_DIR}/fixup.dat;boot/fixup.dat \
                   ${GATEWAY_FW_DIR}/start.elf;boot/start.elf \
                   ${GATEWAY_FW_DIR}/config.txt;boot/config.txt \
                   ${GATEWAY_FW_DIR}/cmdline.txt;boot/cmdline.txt \
                   ${KERNEL_IMAGETYPE};boot/${KERNEL_IMAGETYPE} \"

# Ensure firmware deploy artifacts (including overlays/overlay_map.dtb) exist before wic
do_image_wic[depends] += "gateway-firmware-rpi:do_deploy"
```

## meta-gateway/conf/machine/gateway-rpi0-2w.conf
```bitbake
# SD card partitioning
  IMAGE_FSTYPES: "rpi-sdimg"

require conf/machine/gateway-rpi0-2w.conf
```

## meta-gateway/recipes-kernel/linux/files/defconfig
```kconfig
CONFIG_PREEMPT_RT_FULL=y
CONFIG_HZ_1000=y
CONFIG_HIGH_RES_TIMERS=y
CONFIG_PREEMPTIRQ_EVENTS=y
CONFIG_LOCKDEP_SUPPORT=y
CONFIG_DEBUG_LOCK_ALLOC=y
CONFIG_RCU_NOCB_CPU=y
CONFIG_RCU_NOCB_CPU_DEFAULT=y
CONFIG_PREEMPT_NOTIFIERS=y
CONFIG_TRACE_IRQFLAGS_SUPPORT=y
CONFIG_DEBUG_PREEMPT=y
CONFIG_DEBUG_SPINLOCK=y
CONFIG_DEBUG_MUTEXES=y
CONFIG_DEBUG_RWSEMS=y
CONFIG_DEBUG_ATOMIC_SLEEP=y
CONFIG_DEBUG_OBJECTS_RCU_HEAD=y
CONFIG_DEBUG_OBJECTS=y
CONFIG_DEBUG_OBJECTS_FREE=y
CONFIG_DEBUG_OBJECTS_LEAKAGE=y
CONFIG_SCHED_STACK_END_CHECK=y
CONFIG_TIMER_STATS=y
CONFIG_SCHED_INFO=y
CONFIG_SCHED_DEBUG=y
CONFIG_SCHED_DEADLINE=y
CONFIG_PREEMPTION=y
CONFIG_PREEMPT_COUNT=y
CONFIG_PREEMPT=y
CONFIG_SMP=y
CONFIG_TICK_ONESHOT=y
CONFIG_NO_HZ_FULL=y
CONFIG_IRQ_TIME_ACCOUNTING=y

CONFIG_BRCMFMAC=y
CONFIG_BRCMFMAC_SDIO=y
CONFIG_CFG80211=y
CONFIG_MAC80211=y
CONFIG_WLAN=y
CONFIG_WLAN_BRCM=y
CONFIG_WIRELESS=y
CONFIG_WPA_SUPPLICANT=y

CONFIG_BCM2709_DT=y
CONFIG_ARM64=y
CONFIG_ARCH_BCM2835_CPUFREQ=y
CONFIG_BCM2835_MBOX=y

CONFIG_SERIAL_AMBA_PL011=y
CONFIG_SERIAL_AMBA_PL011_CONSOLE=y
CONFIG_HW_RANDOM_BCM2835=y
```
